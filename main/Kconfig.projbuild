## main/Kconfig.projbuild
```kconfig
menu "ESP32-CAM Home Camera"

    config APP_PROV_AP_PASSWORD
        string "Provisioning AP password"
        default "esp32cam"
        help
            SoftAP 配网热点的密码（WPA2，最少 8 位）。
            配网成功或超时后热点自动关闭。

    config APP_PROV_AP_TIMEOUT_SEC
        int "Provisioning AP timeout (seconds)"
        default 300
        help
            配网热点最长存活时间。超时后关闭热点；
            若已有凭据则转连 STA，否则进入待机等待复位。

    config APP_BOOT_LOOP_THRESHOLD
        int "Boot-loop reset threshold"
        default 3
        help
            连续快速重启达到该次数即清空 WiFi 凭据并进入配网模式。

    config APP_BOOT_LOOP_SETTLE_SEC
        int "Boot-loop settle time (seconds)"
        default 30
        help
            设备正常运行超过该时长后重置重启计数，避免误触发清凭据。

    config APP_RECONNECT_BACKOFF_MAX_SEC
        int "Max WiFi reconnect backoff (seconds)"
        default 60
        help
            WiFi 断线后指数退避重连的上限。

    config APP_MQTT_TLS
        bool "Enable TLS for MQTT"
        default n
        help
            局域网 MQTT 默认不上 TLS 以节省约 35-45KB 堆。
            仅在 MQTT broker 明确需要加密时开启。

endmenu
```
